## components/grownode/Kconfig
```kconfig
menu "GrowNode Configuration"

        
    config GROWNODE_RESET_FLASH
    	bool "Reset Flash at every startup"
    	default false
    		
    config GROWNODE_WIFI_ENABLED
    	bool "Enable Networking"
    	default false
    	help
    		If false, reduces memory consumption

    choice GROWNODE_PROV_TRANSPORT
        bool "Provisioning Transport"
        default GROWNODE_PROV_TRANSPORT_SOFTAP
        depends on GROWNODE_WIFI_ENABLED
        help
            Wi-Fi provisioning component offers both, SoftAP and BLE transports. Choose any one.

        config GROWNODE_PROV_TRANSPORT_BLE
            bool "BLE"
            select BT_ENABLED
            depends on IDF_TARGET_ESP32
        config GROWNODE_PROV_TRANSPORT_SOFTAP
            bool "Soft AP"
    endchoice

    choice GROWNODE_MQTT_PROTOCOL
        bool "MQTT Protocol"
        default GROWNODE_MQTT_LEGACY_PROTOCOL
        depends on GROWNODE_WIFI_ENABLED
        help
            Choose among legacy and HOMIE protocol
        config GROWNODE_MQTT_HOMIE_PROTOCOL
            bool "Homie"
        config GROWNODE_MQTT_LEGACY_PROTOCOL
            bool "Legacy"
    endchoice

    config GROWNODE_PROV_TRANSPORT
        int
        default 1 if GROWNODE_PROV_TRANSPORT_BLE
        default 2 if GROWNODE_PROV_TRANSPORT_SOFTAP
        depends on GROWNODE_WIFI_ENABLED
        
    config GROWNODE_MQTT_BUFFER_SIZE
        int "Size of maximum mqtt payload"
        default 4096
        depends on GROWNODE_WIFI_ENABLED
               
#    config GROWNODE_KEEPALIVE_TIMER_SEC
#		int "Kepalive message (sec)"
#    	depends on GROWNODE_WIFI_ENABLED
#    	default 60
    	
#    config GROWNODE_PROV_SECURITY
#    	bool "Provisioning security"
#    	depends on GROWNODE_PROV_TRANSPORT_SOFTAP
#    	default true
    	
#	config GROWNODE_PROV_POP
#    	string "SoftAP Proof of Possession"
#    	default "grownode"
#    	depends on GROWNODE_PROV_TRANSPORT_SOFTAP
#    	help
#    		Password to prove provisioning is coming from trusted source
    	
   	config GROWNODE_PROV_SOFTAP_PREFIX
    	string "SoftAP Prefix"
    	default "GROWNODE_"
    	depends on GROWNODE_PROV_TRANSPORT_SOFTAP
    	help
    		Name of the WiFi Network. the final will be prefix+"-"+6 MAC address letters

#	config GROWNODE_FIRMWARE_URL
#    	string "Firmware URL"
#    	default "http://discoboy.duckdns.org/esp/GrowNode2.bin"
#    	depends on GROWNODE_WIFI_ENABLED
#    	help
#     		Firmware URL to update
    		
#	config GROWNODE_MQTT_URL
#    	string "MQTT URL"
#    	default "192.168.1.10:1883"
#    	depends on GROWNODE_WIFI_ENABLED
#    	help
#    		MQTT URL to connect to
    		
#	config GROWNODE_MQTT_BASE_TOPIC
#    	string "Base MQTT Topic"
#    	default "/grownode"
#    	depends on GROWNODE_WIFI_ENABLED
#    	help
#    		base topic, default is "/grownode"
    		
#    config GROWNODE_MQTT_MAC_ADDRESS_PREFIX_TOPIC
#    	bool "Add MAC Address of the board in the topic prefix"
#    	depends on GROWNODE_WIFI_ENABLED
#    	default false
    		
#    config GROWNODE_MQTT_DISCOVERY_ENABLED
#    	bool "Enable MQTT Discovery"
#    	default true
#    	depends on GROWNODE_WIFI_ENABLED
#    	help
#    		Enable Sensors to be discovered through network via MQTT (useful in Home Assistant)
    		
#   	config GROWNODE_MQTT_DISCOVERY_PREFIX
#    	string "Discovery MQTT Topic"
#    	default "homeassistant"
#    	depends on GROWNODE_WIFI_ENABLED && GROWNODE_MQTT_DISCOVERY_ENABLED
#    	help
#    		MQTT Discovery prefix, default is "homeassistant"
    		
#    config GROWNODE_SNTP_SERVER_NAME
#        string "SNTP Server Name"
#        default "pool.ntp.org"
#        depends on GROWNODE_WIFI_ENABLED
#        help
#            Default SNTP Server which is used for time synchronization.
           
    config GROWNODE_DISPLAY_ENABLED
    	depends on LVGL_PATH
    	bool "Enable Display"
    	default false
    	help
    		If false, reduces memory consumption 




endmenu
```

## main/Kconfig.projbuild
```kconfig
menu "GrowNode Configuration"

    choice GROWNODE_PROV_TRANSPORT
        bool "Provisioning Transport"
        default GROWNODE_PROV_TRANSPORT_SOFTAP
        help
            Wi-Fi provisioning component offers both, SoftAP and BLE transports. Choose any one.

        config GROWNODE_PROV_TRANSPORT_BLE
            bool "BLE"
            select BT_ENABLED
            depends on IDF_TARGET_ESP32
        config GROWNODE_PROV_TRANSPORT_SOFTAP
            bool "Soft AP"
    endchoice

    config GROWNODE_PROV_TRANSPORT
        int
        default 1 if GROWNODE_PROV_TRANSPORT_BLE
        default 2 if GROWNODE_PROV_TRANSPORT_SOFTAP
        
    config GROWNODE_RESET_PROVISIONED
    	bool "Reset Provisioning Status at every startup"
    	default false
    	
   	config GROWNODE_PROV_SOFTAP_PREFIX
    	string "SoftAP Prefix"
    	default "GROWNODE_"
    	help
    		Name of the WiFi Network. the final will be prefix+"-"+6 MAC address letters

   	config GROWNODE_FIRMWARE_URL
    	string "Firmware URL"
    	default "http://discoboy.duckdns.org/esp/GrowNode2.bin"
    	help
    		Firmware URL to update
    		
   	config GROWNODE_MQTT_URL
    	string "MQTT URL"
    	default "192.168.1.10:1883"
    	help
    		MQTT URL to connect to
    		
   	config GROWNODE_MQTT_BASE_TOPIC
    	string "Base MQTT Topic"
    	default "/grownode"
    	help
    		base topic, default is "/grownode"
    		
    config GROWNODE_SNTP_SERVER_NAME
        string "SNTP Server Name"
        default "pool.ntp.org"
        help
            Default SNTP Server which is used for time synchronization.
           
    config GROWNODE_DISPLAY_PRESENT
    	bool "Init Display"
    	default true
    	help
    		If false, reduces memory consumption 


endmenu
```

## sdkconfig.defaults
```kconfig
#
# Partition Table
#
CONFIG_PARTITION_TABLE_CUSTOM=y
CONFIG_PARTITION_TABLE_CUSTOM_FILENAME="partitions.csv"
CONFIG_PARTITION_TABLE_FILENAME="partitions.csv"
CONFIG_PARTITION_TABLE_OFFSET=0x8000
CONFIG_PARTITION_TABLE_MD5=y
# end of Partition Table

#
# Serial flasher config
#
CONFIG_ESPTOOLPY_FLASHSIZE_4MB=y
CONFIG_ESPTOOLPY_FLASHSIZE="4MB"
#
# end of Serial flasher config
#

#
# Log output
#
CONFIG_LOG_DEFAULT_LEVEL_INFO=y
CONFIG_LOG_DEFAULT_LEVEL=3
CONFIG_LOG_MAXIMUM_EQUALS_DEFAULT=y
CONFIG_LOG_MAXIMUM_LEVEL=3
CONFIG_LOG_COLORS=y
CONFIG_LOG_TIMESTAMP_SOURCE_RTOS=y
# end of Log output



#
# LVGL configuration
#
CONFIG_LV_CONF_SKIP=y

#
# Color settings
#
CONFIG_LV_COLOR_DEPTH_16=y
CONFIG_LV_COLOR_DEPTH=16
CONFIG_LV_COLOR_MIX_ROUND_OFS=128
CONFIG_LV_COLOR_CHROMA_KEY_HEX=0x00FF00
# end of Color settings

#
# Feature configuration
#


#
# Font usage
#

#
# Enable built-in fonts
#
CONFIG_LV_FONT_MONTSERRAT_14=y
# end of Enable built-in fonts

CONFIG_LV_FONT_DEFAULT_MONTSERRAT_14=y
# end of Font usage

#
# Themes
#
CONFIG_LV_USE_THEME_BASIC=y
# end of Themes

#
# Layouts
#
CONFIG_LV_USE_FLEX=y
CONFIG_LV_USE_GRID=y
# end of Layouts

#
# 3rd Party Libraries
#
CONFIG_LV_USE_FS_STDIO=0
CONFIG_LV_USE_FS_POSIX=0
CONFIG_LV_USE_FS_WIN32=0
CONFIG_LV_USE_FS_FATFS=0
# end of 3rd Party Libraries

#
# Others
#
CONFIG_LV_USE_SNAPSHOT=y
# end of Others

#
# LVGL ESP Drivers
#

#
# LVGL TFT Display controller
#
CONFIG_LV_PREDEFINED_DISPLAY_NONE=y
CONFIG_LV_TFT_DISPLAY_CONTROLLER_ILI9341=y
CONFIG_LV_TFT_DISPLAY_PROTOCOL_SPI=y
CONFIG_LV_DISPLAY_ORIENTATION_PORTRAIT=y
CONFIG_LV_DISPLAY_ORIENTATION=0
CONFIG_LV_PREDEFINED_PINS_NONE=y
CONFIG_LV_TFT_DISPLAY_USER_CONTROLLER_ILI9341=y
CONFIG_CUSTOM_DISPLAY_BUFFER_SIZE=y
CONFIG_CUSTOM_DISPLAY_BUFFER_BYTES=1024
CONFIG_LV_TFT_DISPLAY_SPI_VSPI=y
CONFIG_LV_TFT_DISPLAY_SPI_TRANS_MODE_SIO=y
CONFIG_LV_TFT_DISPLAY_SPI_FULL_DUPLEX=y
CONFIG_LV_TFT_USE_CUSTOM_SPI_CLK_DIVIDER=y
CONFIG_LV_TFT_SPI_CLK_DIVIDER_4=y
CONFIG_LV_TFT_CUSTOM_SPI_CLK_DIVIDER=4

#
# Display Pin Assignments
#
CONFIG_LV_DISP_SPI_MOSI=23
CONFIG_LV_DISPLAY_USE_SPI_MISO=y
CONFIG_LV_DISP_SPI_MISO=19
CONFIG_LV_DISP_SPI_INPUT_DELAY_NS=0
CONFIG_LV_DISP_SPI_CLK=18
CONFIG_LV_DISPLAY_USE_SPI_CS=y
CONFIG_LV_DISP_SPI_CS=5
CONFIG_LV_DISPLAY_USE_DC=y
CONFIG_LV_DISP_PIN_DC=16
CONFIG_LV_DISP_USE_RST=y
CONFIG_LV_DISP_PIN_RST=2
CONFIG_LV_DISP_PIN_BUSY=35
CONFIG_LV_ENABLE_BACKLIGHT_CONTROL=y
CONFIG_LV_BACKLIGHT_ACTIVE_LVL=y
CONFIG_LV_DISP_PIN_BCKL=17
CONFIG_LV_DISP_PIN_SDA=5
CONFIG_LV_DISP_PIN_SCL=4
# end of Display Pin Assignments
# end of LVGL TFT Display controller

#
# LVGL Touch controller
#
CONFIG_LV_TOUCH_CONTROLLER=1
# CONFIG_LV_TOUCH_CONTROLLER_NONE is not set
CONFIG_LV_TOUCH_CONTROLLER_XPT2046=y
# CONFIG_LV_TOUCH_CONTROLLER_FT6X06 is not set
# CONFIG_LV_TOUCH_CONTROLLER_STMPE610 is not set
# CONFIG_LV_TOUCH_CONTROLLER_ADCRAW is not set
# CONFIG_LV_TOUCH_CONTROLLER_FT81X is not set
# CONFIG_LV_TOUCH_CONTROLLER_RA8875 is not set
CONFIG_LV_TOUCH_DRIVER_PROTOCOL_SPI=y
# CONFIG_LV_TOUCH_CONTROLLER_SPI_HSPI is not set
CONFIG_LV_TOUCH_CONTROLLER_SPI_VSPI=y

#
# Touchpanel (XPT2046) Pin Assignments
#
CONFIG_LV_TOUCH_SPI_MISO=19
CONFIG_LV_TOUCH_SPI_MOSI=23
CONFIG_LV_TOUCH_SPI_CLK=18
CONFIG_LV_TOUCH_SPI_CS=25
CONFIG_LV_TOUCH_PIN_IRQ=26
# end of Touchpanel (XPT2046) Pin Assignments

#
# Touchpanel Configuration (XPT2046)
#
CONFIG_LV_TOUCH_X_MIN=0
CONFIG_LV_TOUCH_Y_MIN=200
CONFIG_LV_TOUCH_X_MAX=1800
CONFIG_LV_TOUCH_Y_MAX=1800
CONFIG_LV_TOUCH_XY_SWAP=y
CONFIG_LV_TOUCH_INVERT_X=y
# CONFIG_LV_TOUCH_INVERT_Y is not set
CONFIG_LV_TOUCH_DETECT_IRQ=y
# CONFIG_LV_TOUCH_DETECT_IRQ_PRESSURE is not set
# CONFIG_LV_TOUCH_DETECT_PRESSURE is not set
# end of Touchpanel Configuration (XPT2046)
# end of LVGL Touch controller

# end of LVGL ESP Drivers
```
